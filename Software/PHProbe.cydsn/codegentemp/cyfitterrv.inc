    IF :LNOT::DEF:INCLUDED_CYFITTERRV_INC
INCLUDED_CYFITTERRV_INC EQU 1
    GET cydevicerv_trm.inc

; ADC_cy_psoc4_sar
ADC_cy_psoc4_sar__SAR_CTRL EQU CYREG_SAR_CTRL
ADC_cy_psoc4_sar__SAR_INTR EQU CYREG_SAR_INTR
ADC_cy_psoc4_sar__SAR_INTR_CAUSE EQU CYREG_SAR_INTR_CAUSE
ADC_cy_psoc4_sar__SAR_INTR_MASK EQU CYREG_SAR_INTR_MASK
ADC_cy_psoc4_sar__SAR_INTR_MASKED EQU CYREG_SAR_INTR_MASKED
ADC_cy_psoc4_sar__SAR_INTR_SET EQU CYREG_SAR_INTR_SET
ADC_cy_psoc4_sar__SAR_NUMBER EQU 0
ADC_cy_psoc4_sar__SAR_RANGE_COND EQU CYREG_SAR_RANGE_COND
ADC_cy_psoc4_sar__SAR_RANGE_INTR_MASK EQU CYREG_SAR_RANGE_INTR_MASK
ADC_cy_psoc4_sar__SAR_RANGE_INTR_MASKED EQU CYREG_SAR_RANGE_INTR_MASKED
ADC_cy_psoc4_sar__SAR_RANGE_INTR_SET EQU CYREG_SAR_RANGE_INTR_SET
ADC_cy_psoc4_sar__SAR_RANGE_THRES EQU CYREG_SAR_RANGE_THRES
ADC_cy_psoc4_sar__SAR_SAMPLE_CTRL EQU CYREG_SAR_SAMPLE_CTRL
ADC_cy_psoc4_sar__SAR_SAMPLE_TIME01 EQU CYREG_SAR_SAMPLE_TIME01
ADC_cy_psoc4_sar__SAR_SAMPLE_TIME23 EQU CYREG_SAR_SAMPLE_TIME23
ADC_cy_psoc4_sar__SAR_SATURATE_INTR_MASK EQU CYREG_SAR_SATURATE_INTR_MASK
ADC_cy_psoc4_sar__SAR_SATURATE_INTR_MASKED EQU CYREG_SAR_SATURATE_INTR_MASKED
ADC_cy_psoc4_sar__SAR_SATURATE_INTR_SET EQU CYREG_SAR_SATURATE_INTR_SET
ADC_cy_psoc4_sar__SAR_STATUS EQU CYREG_SAR_STATUS

; ADC_intClock
ADC_intClock__DIVIDER_MASK EQU 0x0000FFFF
ADC_intClock__ENABLE EQU CYREG_CLK_DIVIDER_A00
ADC_intClock__ENABLE_MASK EQU 0x80000000
ADC_intClock__MASK EQU 0x80000000
ADC_intClock__REGISTER EQU CYREG_CLK_DIVIDER_A00

; ADC_IRQ
ADC_IRQ__INTC_CLR_EN_REG EQU CYREG_CM0_ICER
ADC_IRQ__INTC_CLR_PD_REG EQU CYREG_CM0_ICPR
ADC_IRQ__INTC_MASK EQU 0x4000
ADC_IRQ__INTC_NUMBER EQU 14
ADC_IRQ__INTC_PRIOR_MASK EQU 0xC00000
ADC_IRQ__INTC_PRIOR_NUM EQU 3
ADC_IRQ__INTC_PRIOR_REG EQU CYREG_CM0_IPR3
ADC_IRQ__INTC_SET_EN_REG EQU CYREG_CM0_ISER
ADC_IRQ__INTC_SET_PD_REG EQU CYREG_CM0_ISPR

; CALI
CALI__0__DM__MASK EQU 0xE00000
CALI__0__DM__SHIFT EQU 21
CALI__0__DR EQU CYREG_PRT2_DR
CALI__0__HSIOM EQU CYREG_HSIOM_PORT_SEL2
CALI__0__HSIOM_MASK EQU 0xF0000000
CALI__0__HSIOM_SHIFT EQU 28
CALI__0__INTCFG EQU CYREG_PRT2_INTCFG
CALI__0__INTSTAT EQU CYREG_PRT2_INTSTAT
CALI__0__MASK EQU 0x80
CALI__0__PA__CFG0 EQU CYREG_UDB_PA2_CFG0
CALI__0__PA__CFG1 EQU CYREG_UDB_PA2_CFG1
CALI__0__PA__CFG10 EQU CYREG_UDB_PA2_CFG10
CALI__0__PA__CFG11 EQU CYREG_UDB_PA2_CFG11
CALI__0__PA__CFG12 EQU CYREG_UDB_PA2_CFG12
CALI__0__PA__CFG13 EQU CYREG_UDB_PA2_CFG13
CALI__0__PA__CFG14 EQU CYREG_UDB_PA2_CFG14
CALI__0__PA__CFG2 EQU CYREG_UDB_PA2_CFG2
CALI__0__PA__CFG3 EQU CYREG_UDB_PA2_CFG3
CALI__0__PA__CFG4 EQU CYREG_UDB_PA2_CFG4
CALI__0__PA__CFG5 EQU CYREG_UDB_PA2_CFG5
CALI__0__PA__CFG6 EQU CYREG_UDB_PA2_CFG6
CALI__0__PA__CFG7 EQU CYREG_UDB_PA2_CFG7
CALI__0__PA__CFG8 EQU CYREG_UDB_PA2_CFG8
CALI__0__PA__CFG9 EQU CYREG_UDB_PA2_CFG9
CALI__0__PC EQU CYREG_PRT2_PC
CALI__0__PC2 EQU CYREG_PRT2_PC2
CALI__0__PORT EQU 2
CALI__0__PS EQU CYREG_PRT2_PS
CALI__0__SHIFT EQU 7
CALI__DR EQU CYREG_PRT2_DR
CALI__INTCFG EQU CYREG_PRT2_INTCFG
CALI__INTSTAT EQU CYREG_PRT2_INTSTAT
CALI__MASK EQU 0x80
CALI__PA__CFG0 EQU CYREG_UDB_PA2_CFG0
CALI__PA__CFG1 EQU CYREG_UDB_PA2_CFG1
CALI__PA__CFG10 EQU CYREG_UDB_PA2_CFG10
CALI__PA__CFG11 EQU CYREG_UDB_PA2_CFG11
CALI__PA__CFG12 EQU CYREG_UDB_PA2_CFG12
CALI__PA__CFG13 EQU CYREG_UDB_PA2_CFG13
CALI__PA__CFG14 EQU CYREG_UDB_PA2_CFG14
CALI__PA__CFG2 EQU CYREG_UDB_PA2_CFG2
CALI__PA__CFG3 EQU CYREG_UDB_PA2_CFG3
CALI__PA__CFG4 EQU CYREG_UDB_PA2_CFG4
CALI__PA__CFG5 EQU CYREG_UDB_PA2_CFG5
CALI__PA__CFG6 EQU CYREG_UDB_PA2_CFG6
CALI__PA__CFG7 EQU CYREG_UDB_PA2_CFG7
CALI__PA__CFG8 EQU CYREG_UDB_PA2_CFG8
CALI__PA__CFG9 EQU CYREG_UDB_PA2_CFG9
CALI__PC EQU CYREG_PRT2_PC
CALI__PC2 EQU CYREG_PRT2_PC2
CALI__PORT EQU 2
CALI__PS EQU CYREG_PRT2_PS
CALI__SHIFT EQU 7

; Clock_1
Clock_1__DIVIDER_MASK EQU 0x0000FFFF
Clock_1__ENABLE EQU CYREG_CLK_DIVIDER_C00
Clock_1__ENABLE_MASK EQU 0x80000000
Clock_1__MASK EQU 0x80000000
Clock_1__REGISTER EQU CYREG_CLK_DIVIDER_C00

; Opamp_1_cy_psoc4_abuf
Opamp_1_cy_psoc4_abuf__COMP_STAT EQU CYREG_CTBM_COMP_STAT
Opamp_1_cy_psoc4_abuf__COMP_STAT_SHIFT EQU 16
Opamp_1_cy_psoc4_abuf__CTBM_CTB_CTRL EQU CYREG_CTBM_CTB_CTRL
Opamp_1_cy_psoc4_abuf__INTR EQU CYREG_CTBM_INTR
Opamp_1_cy_psoc4_abuf__INTR_MASK EQU CYREG_CTBM_INTR_MASK
Opamp_1_cy_psoc4_abuf__INTR_MASK_SHIFT EQU 1
Opamp_1_cy_psoc4_abuf__INTR_MASKED EQU CYREG_CTBM_INTR_MASKED
Opamp_1_cy_psoc4_abuf__INTR_MASKED_SHIFT EQU 1
Opamp_1_cy_psoc4_abuf__INTR_SET EQU CYREG_CTBM_INTR_SET
Opamp_1_cy_psoc4_abuf__INTR_SET_SHIFT EQU 1
Opamp_1_cy_psoc4_abuf__INTR_SHIFT EQU 1
Opamp_1_cy_psoc4_abuf__OA_COMP_TRIM EQU CYREG_CTBM_OA1_COMP_TRIM
Opamp_1_cy_psoc4_abuf__OA_NUMBER EQU 1
Opamp_1_cy_psoc4_abuf__OA_OFFSET_TRIM EQU CYREG_CTBM_OA1_OFFSET_TRIM
Opamp_1_cy_psoc4_abuf__OA_RES_CTRL EQU CYREG_CTBM_OA_RES1_CTRL
Opamp_1_cy_psoc4_abuf__OA_SLOPE_OFFSET_TRIM EQU CYREG_CTBM_OA1_SLOPE_OFFSET_TRIM

; RED_LED
RED_LED__0__DM__MASK EQU 0xE00
RED_LED__0__DM__SHIFT EQU 9
RED_LED__0__DR EQU CYREG_PRT2_DR
RED_LED__0__HSIOM EQU CYREG_HSIOM_PORT_SEL2
RED_LED__0__HSIOM_MASK EQU 0x0000F000
RED_LED__0__HSIOM_SHIFT EQU 12
RED_LED__0__INTCFG EQU CYREG_PRT2_INTCFG
RED_LED__0__INTSTAT EQU CYREG_PRT2_INTSTAT
RED_LED__0__MASK EQU 0x08
RED_LED__0__PA__CFG0 EQU CYREG_UDB_PA2_CFG0
RED_LED__0__PA__CFG1 EQU CYREG_UDB_PA2_CFG1
RED_LED__0__PA__CFG10 EQU CYREG_UDB_PA2_CFG10
RED_LED__0__PA__CFG11 EQU CYREG_UDB_PA2_CFG11
RED_LED__0__PA__CFG12 EQU CYREG_UDB_PA2_CFG12
RED_LED__0__PA__CFG13 EQU CYREG_UDB_PA2_CFG13
RED_LED__0__PA__CFG14 EQU CYREG_UDB_PA2_CFG14
RED_LED__0__PA__CFG2 EQU CYREG_UDB_PA2_CFG2
RED_LED__0__PA__CFG3 EQU CYREG_UDB_PA2_CFG3
RED_LED__0__PA__CFG4 EQU CYREG_UDB_PA2_CFG4
RED_LED__0__PA__CFG5 EQU CYREG_UDB_PA2_CFG5
RED_LED__0__PA__CFG6 EQU CYREG_UDB_PA2_CFG6
RED_LED__0__PA__CFG7 EQU CYREG_UDB_PA2_CFG7
RED_LED__0__PA__CFG8 EQU CYREG_UDB_PA2_CFG8
RED_LED__0__PA__CFG9 EQU CYREG_UDB_PA2_CFG9
RED_LED__0__PC EQU CYREG_PRT2_PC
RED_LED__0__PC2 EQU CYREG_PRT2_PC2
RED_LED__0__PORT EQU 2
RED_LED__0__PS EQU CYREG_PRT2_PS
RED_LED__0__SHIFT EQU 3
RED_LED__DR EQU CYREG_PRT2_DR
RED_LED__INTCFG EQU CYREG_PRT2_INTCFG
RED_LED__INTSTAT EQU CYREG_PRT2_INTSTAT
RED_LED__MASK EQU 0x08
RED_LED__PA__CFG0 EQU CYREG_UDB_PA2_CFG0
RED_LED__PA__CFG1 EQU CYREG_UDB_PA2_CFG1
RED_LED__PA__CFG10 EQU CYREG_UDB_PA2_CFG10
RED_LED__PA__CFG11 EQU CYREG_UDB_PA2_CFG11
RED_LED__PA__CFG12 EQU CYREG_UDB_PA2_CFG12
RED_LED__PA__CFG13 EQU CYREG_UDB_PA2_CFG13
RED_LED__PA__CFG14 EQU CYREG_UDB_PA2_CFG14
RED_LED__PA__CFG2 EQU CYREG_UDB_PA2_CFG2
RED_LED__PA__CFG3 EQU CYREG_UDB_PA2_CFG3
RED_LED__PA__CFG4 EQU CYREG_UDB_PA2_CFG4
RED_LED__PA__CFG5 EQU CYREG_UDB_PA2_CFG5
RED_LED__PA__CFG6 EQU CYREG_UDB_PA2_CFG6
RED_LED__PA__CFG7 EQU CYREG_UDB_PA2_CFG7
RED_LED__PA__CFG8 EQU CYREG_UDB_PA2_CFG8
RED_LED__PA__CFG9 EQU CYREG_UDB_PA2_CFG9
RED_LED__PC EQU CYREG_PRT2_PC
RED_LED__PC2 EQU CYREG_PRT2_PC2
RED_LED__PORT EQU 2
RED_LED__PS EQU CYREG_PRT2_PS
RED_LED__SHIFT EQU 3

; ProbeGND
ProbeGND__0__DM__MASK EQU 0x38
ProbeGND__0__DM__SHIFT EQU 3
ProbeGND__0__DR EQU CYREG_PRT2_DR
ProbeGND__0__HSIOM EQU CYREG_HSIOM_PORT_SEL2
ProbeGND__0__HSIOM_MASK EQU 0x000000F0
ProbeGND__0__HSIOM_SHIFT EQU 4
ProbeGND__0__INTCFG EQU CYREG_PRT2_INTCFG
ProbeGND__0__INTSTAT EQU CYREG_PRT2_INTSTAT
ProbeGND__0__MASK EQU 0x02
ProbeGND__0__PA__CFG0 EQU CYREG_UDB_PA2_CFG0
ProbeGND__0__PA__CFG1 EQU CYREG_UDB_PA2_CFG1
ProbeGND__0__PA__CFG10 EQU CYREG_UDB_PA2_CFG10
ProbeGND__0__PA__CFG11 EQU CYREG_UDB_PA2_CFG11
ProbeGND__0__PA__CFG12 EQU CYREG_UDB_PA2_CFG12
ProbeGND__0__PA__CFG13 EQU CYREG_UDB_PA2_CFG13
ProbeGND__0__PA__CFG14 EQU CYREG_UDB_PA2_CFG14
ProbeGND__0__PA__CFG2 EQU CYREG_UDB_PA2_CFG2
ProbeGND__0__PA__CFG3 EQU CYREG_UDB_PA2_CFG3
ProbeGND__0__PA__CFG4 EQU CYREG_UDB_PA2_CFG4
ProbeGND__0__PA__CFG5 EQU CYREG_UDB_PA2_CFG5
ProbeGND__0__PA__CFG6 EQU CYREG_UDB_PA2_CFG6
ProbeGND__0__PA__CFG7 EQU CYREG_UDB_PA2_CFG7
ProbeGND__0__PA__CFG8 EQU CYREG_UDB_PA2_CFG8
ProbeGND__0__PA__CFG9 EQU CYREG_UDB_PA2_CFG9
ProbeGND__0__PC EQU CYREG_PRT2_PC
ProbeGND__0__PC2 EQU CYREG_PRT2_PC2
ProbeGND__0__PORT EQU 2
ProbeGND__0__PS EQU CYREG_PRT2_PS
ProbeGND__0__SHIFT EQU 1
ProbeGND__DR EQU CYREG_PRT2_DR
ProbeGND__INTCFG EQU CYREG_PRT2_INTCFG
ProbeGND__INTSTAT EQU CYREG_PRT2_INTSTAT
ProbeGND__MASK EQU 0x02
ProbeGND__PA__CFG0 EQU CYREG_UDB_PA2_CFG0
ProbeGND__PA__CFG1 EQU CYREG_UDB_PA2_CFG1
ProbeGND__PA__CFG10 EQU CYREG_UDB_PA2_CFG10
ProbeGND__PA__CFG11 EQU CYREG_UDB_PA2_CFG11
ProbeGND__PA__CFG12 EQU CYREG_UDB_PA2_CFG12
ProbeGND__PA__CFG13 EQU CYREG_UDB_PA2_CFG13
ProbeGND__PA__CFG14 EQU CYREG_UDB_PA2_CFG14
ProbeGND__PA__CFG2 EQU CYREG_UDB_PA2_CFG2
ProbeGND__PA__CFG3 EQU CYREG_UDB_PA2_CFG3
ProbeGND__PA__CFG4 EQU CYREG_UDB_PA2_CFG4
ProbeGND__PA__CFG5 EQU CYREG_UDB_PA2_CFG5
ProbeGND__PA__CFG6 EQU CYREG_UDB_PA2_CFG6
ProbeGND__PA__CFG7 EQU CYREG_UDB_PA2_CFG7
ProbeGND__PA__CFG8 EQU CYREG_UDB_PA2_CFG8
ProbeGND__PA__CFG9 EQU CYREG_UDB_PA2_CFG9
ProbeGND__PC EQU CYREG_PRT2_PC
ProbeGND__PC2 EQU CYREG_PRT2_PC2
ProbeGND__PORT EQU 2
ProbeGND__PS EQU CYREG_PRT2_PS
ProbeGND__SHIFT EQU 1

; Calibrate
Calibrate__INTC_CLR_EN_REG EQU CYREG_CM0_ICER
Calibrate__INTC_CLR_PD_REG EQU CYREG_CM0_ICPR
Calibrate__INTC_MASK EQU 0x01
Calibrate__INTC_NUMBER EQU 0
Calibrate__INTC_PRIOR_MASK EQU 0xC0
Calibrate__INTC_PRIOR_NUM EQU 3
Calibrate__INTC_PRIOR_REG EQU CYREG_CM0_IPR0
Calibrate__INTC_SET_EN_REG EQU CYREG_CM0_ISER
Calibrate__INTC_SET_PD_REG EQU CYREG_CM0_ISPR

; GREEN_LED
GREEN_LED__0__DM__MASK EQU 0x1C0
GREEN_LED__0__DM__SHIFT EQU 6
GREEN_LED__0__DR EQU CYREG_PRT2_DR
GREEN_LED__0__HSIOM EQU CYREG_HSIOM_PORT_SEL2
GREEN_LED__0__HSIOM_MASK EQU 0x00000F00
GREEN_LED__0__HSIOM_SHIFT EQU 8
GREEN_LED__0__INTCFG EQU CYREG_PRT2_INTCFG
GREEN_LED__0__INTSTAT EQU CYREG_PRT2_INTSTAT
GREEN_LED__0__MASK EQU 0x04
GREEN_LED__0__PA__CFG0 EQU CYREG_UDB_PA2_CFG0
GREEN_LED__0__PA__CFG1 EQU CYREG_UDB_PA2_CFG1
GREEN_LED__0__PA__CFG10 EQU CYREG_UDB_PA2_CFG10
GREEN_LED__0__PA__CFG11 EQU CYREG_UDB_PA2_CFG11
GREEN_LED__0__PA__CFG12 EQU CYREG_UDB_PA2_CFG12
GREEN_LED__0__PA__CFG13 EQU CYREG_UDB_PA2_CFG13
GREEN_LED__0__PA__CFG14 EQU CYREG_UDB_PA2_CFG14
GREEN_LED__0__PA__CFG2 EQU CYREG_UDB_PA2_CFG2
GREEN_LED__0__PA__CFG3 EQU CYREG_UDB_PA2_CFG3
GREEN_LED__0__PA__CFG4 EQU CYREG_UDB_PA2_CFG4
GREEN_LED__0__PA__CFG5 EQU CYREG_UDB_PA2_CFG5
GREEN_LED__0__PA__CFG6 EQU CYREG_UDB_PA2_CFG6
GREEN_LED__0__PA__CFG7 EQU CYREG_UDB_PA2_CFG7
GREEN_LED__0__PA__CFG8 EQU CYREG_UDB_PA2_CFG8
GREEN_LED__0__PA__CFG9 EQU CYREG_UDB_PA2_CFG9
GREEN_LED__0__PC EQU CYREG_PRT2_PC
GREEN_LED__0__PC2 EQU CYREG_PRT2_PC2
GREEN_LED__0__PORT EQU 2
GREEN_LED__0__PS EQU CYREG_PRT2_PS
GREEN_LED__0__SHIFT EQU 2
GREEN_LED__DR EQU CYREG_PRT2_DR
GREEN_LED__INTCFG EQU CYREG_PRT2_INTCFG
GREEN_LED__INTSTAT EQU CYREG_PRT2_INTSTAT
GREEN_LED__MASK EQU 0x04
GREEN_LED__PA__CFG0 EQU CYREG_UDB_PA2_CFG0
GREEN_LED__PA__CFG1 EQU CYREG_UDB_PA2_CFG1
GREEN_LED__PA__CFG10 EQU CYREG_UDB_PA2_CFG10
GREEN_LED__PA__CFG11 EQU CYREG_UDB_PA2_CFG11
GREEN_LED__PA__CFG12 EQU CYREG_UDB_PA2_CFG12
GREEN_LED__PA__CFG13 EQU CYREG_UDB_PA2_CFG13
GREEN_LED__PA__CFG14 EQU CYREG_UDB_PA2_CFG14
GREEN_LED__PA__CFG2 EQU CYREG_UDB_PA2_CFG2
GREEN_LED__PA__CFG3 EQU CYREG_UDB_PA2_CFG3
GREEN_LED__PA__CFG4 EQU CYREG_UDB_PA2_CFG4
GREEN_LED__PA__CFG5 EQU CYREG_UDB_PA2_CFG5
GREEN_LED__PA__CFG6 EQU CYREG_UDB_PA2_CFG6
GREEN_LED__PA__CFG7 EQU CYREG_UDB_PA2_CFG7
GREEN_LED__PA__CFG8 EQU CYREG_UDB_PA2_CFG8
GREEN_LED__PA__CFG9 EQU CYREG_UDB_PA2_CFG9
GREEN_LED__PC EQU CYREG_PRT2_PC
GREEN_LED__PC2 EQU CYREG_PRT2_PC2
GREEN_LED__PORT EQU 2
GREEN_LED__PS EQU CYREG_PRT2_PS
GREEN_LED__SHIFT EQU 2

; ProbeSignal
ProbeSignal__0__DM__MASK EQU 0x07
ProbeSignal__0__DM__SHIFT EQU 0
ProbeSignal__0__DR EQU CYREG_PRT2_DR
ProbeSignal__0__HSIOM EQU CYREG_HSIOM_PORT_SEL2
ProbeSignal__0__HSIOM_MASK EQU 0x0000000F
ProbeSignal__0__HSIOM_SHIFT EQU 0
ProbeSignal__0__INTCFG EQU CYREG_PRT2_INTCFG
ProbeSignal__0__INTSTAT EQU CYREG_PRT2_INTSTAT
ProbeSignal__0__MASK EQU 0x01
ProbeSignal__0__OUT_SEL EQU CYREG_UDB_PA2_CFG10
ProbeSignal__0__OUT_SEL_SHIFT EQU 0
ProbeSignal__0__OUT_SEL_VAL EQU 0
ProbeSignal__0__PA__CFG0 EQU CYREG_UDB_PA2_CFG0
ProbeSignal__0__PA__CFG1 EQU CYREG_UDB_PA2_CFG1
ProbeSignal__0__PA__CFG10 EQU CYREG_UDB_PA2_CFG10
ProbeSignal__0__PA__CFG11 EQU CYREG_UDB_PA2_CFG11
ProbeSignal__0__PA__CFG12 EQU CYREG_UDB_PA2_CFG12
ProbeSignal__0__PA__CFG13 EQU CYREG_UDB_PA2_CFG13
ProbeSignal__0__PA__CFG14 EQU CYREG_UDB_PA2_CFG14
ProbeSignal__0__PA__CFG2 EQU CYREG_UDB_PA2_CFG2
ProbeSignal__0__PA__CFG3 EQU CYREG_UDB_PA2_CFG3
ProbeSignal__0__PA__CFG4 EQU CYREG_UDB_PA2_CFG4
ProbeSignal__0__PA__CFG5 EQU CYREG_UDB_PA2_CFG5
ProbeSignal__0__PA__CFG6 EQU CYREG_UDB_PA2_CFG6
ProbeSignal__0__PA__CFG7 EQU CYREG_UDB_PA2_CFG7
ProbeSignal__0__PA__CFG8 EQU CYREG_UDB_PA2_CFG8
ProbeSignal__0__PA__CFG9 EQU CYREG_UDB_PA2_CFG9
ProbeSignal__0__PC EQU CYREG_PRT2_PC
ProbeSignal__0__PC2 EQU CYREG_PRT2_PC2
ProbeSignal__0__PORT EQU 2
ProbeSignal__0__PS EQU CYREG_PRT2_PS
ProbeSignal__0__SHIFT EQU 0
ProbeSignal__DR EQU CYREG_PRT2_DR
ProbeSignal__INTCFG EQU CYREG_PRT2_INTCFG
ProbeSignal__INTSTAT EQU CYREG_PRT2_INTSTAT
ProbeSignal__MASK EQU 0x01
ProbeSignal__PA__CFG0 EQU CYREG_UDB_PA2_CFG0
ProbeSignal__PA__CFG1 EQU CYREG_UDB_PA2_CFG1
ProbeSignal__PA__CFG10 EQU CYREG_UDB_PA2_CFG10
ProbeSignal__PA__CFG11 EQU CYREG_UDB_PA2_CFG11
ProbeSignal__PA__CFG12 EQU CYREG_UDB_PA2_CFG12
ProbeSignal__PA__CFG13 EQU CYREG_UDB_PA2_CFG13
ProbeSignal__PA__CFG14 EQU CYREG_UDB_PA2_CFG14
ProbeSignal__PA__CFG2 EQU CYREG_UDB_PA2_CFG2
ProbeSignal__PA__CFG3 EQU CYREG_UDB_PA2_CFG3
ProbeSignal__PA__CFG4 EQU CYREG_UDB_PA2_CFG4
ProbeSignal__PA__CFG5 EQU CYREG_UDB_PA2_CFG5
ProbeSignal__PA__CFG6 EQU CYREG_UDB_PA2_CFG6
ProbeSignal__PA__CFG7 EQU CYREG_UDB_PA2_CFG7
ProbeSignal__PA__CFG8 EQU CYREG_UDB_PA2_CFG8
ProbeSignal__PA__CFG9 EQU CYREG_UDB_PA2_CFG9
ProbeSignal__PC EQU CYREG_PRT2_PC
ProbeSignal__PC2 EQU CYREG_PRT2_PC2
ProbeSignal__PORT EQU 2
ProbeSignal__PS EQU CYREG_PRT2_PS
ProbeSignal__SHIFT EQU 0

; Miscellaneous
CYDEV_BCLK__HFCLK__HZ EQU 24000000
CYDEV_BCLK__HFCLK__KHZ EQU 24000
CYDEV_BCLK__HFCLK__MHZ EQU 24
CYDEV_BCLK__SYSCLK__HZ EQU 24000000
CYDEV_BCLK__SYSCLK__KHZ EQU 24000
CYDEV_BCLK__SYSCLK__MHZ EQU 24
CYDEV_CHIP_DIE_LEOPARD EQU 1
CYDEV_CHIP_DIE_PANTHER EQU 6
CYDEV_CHIP_DIE_PSOC4A EQU 3
CYDEV_CHIP_DIE_PSOC5LP EQU 5
CYDEV_CHIP_DIE_UNKNOWN EQU 0
CYDEV_CHIP_FAMILY_PSOC3 EQU 1
CYDEV_CHIP_FAMILY_PSOC4 EQU 2
CYDEV_CHIP_FAMILY_PSOC5 EQU 3
CYDEV_CHIP_FAMILY_UNKNOWN EQU 0
CYDEV_CHIP_FAMILY_USED EQU CYDEV_CHIP_FAMILY_PSOC4
CYDEV_CHIP_JTAG_ID EQU 0x04C81193
CYDEV_CHIP_MEMBER_3A EQU 1
CYDEV_CHIP_MEMBER_4A EQU 3
CYDEV_CHIP_MEMBER_4D EQU 2
CYDEV_CHIP_MEMBER_4F EQU 4
CYDEV_CHIP_MEMBER_5A EQU 6
CYDEV_CHIP_MEMBER_5B EQU 5
CYDEV_CHIP_MEMBER_UNKNOWN EQU 0
CYDEV_CHIP_MEMBER_USED EQU CYDEV_CHIP_MEMBER_4A
CYDEV_CHIP_DIE_EXPECT EQU CYDEV_CHIP_MEMBER_USED
CYDEV_CHIP_DIE_ACTUAL EQU CYDEV_CHIP_DIE_EXPECT
CYDEV_CHIP_REV_LEOPARD_ES1 EQU 0
CYDEV_CHIP_REV_LEOPARD_ES2 EQU 1
CYDEV_CHIP_REV_LEOPARD_ES3 EQU 3
CYDEV_CHIP_REV_LEOPARD_PRODUCTION EQU 3
CYDEV_CHIP_REV_PANTHER_ES0 EQU 0
CYDEV_CHIP_REV_PANTHER_ES1 EQU 1
CYDEV_CHIP_REV_PANTHER_PRODUCTION EQU 1
CYDEV_CHIP_REV_PSOC4A_ES0 EQU 17
CYDEV_CHIP_REV_PSOC4A_PRODUCTION EQU 17
CYDEV_CHIP_REV_PSOC5LP_ES0 EQU 0
CYDEV_CHIP_REV_PSOC5LP_PRODUCTION EQU 0
CYDEV_CHIP_REVISION_3A_ES1 EQU 0
CYDEV_CHIP_REVISION_3A_ES2 EQU 1
CYDEV_CHIP_REVISION_3A_ES3 EQU 3
CYDEV_CHIP_REVISION_3A_PRODUCTION EQU 3
CYDEV_CHIP_REVISION_4A_ES0 EQU 17
CYDEV_CHIP_REVISION_4A_PRODUCTION EQU 17
CYDEV_CHIP_REVISION_4D_PRODUCTION EQU 0
CYDEV_CHIP_REVISION_4F_PRODUCTION EQU 0
CYDEV_CHIP_REVISION_5A_ES0 EQU 0
CYDEV_CHIP_REVISION_5A_ES1 EQU 1
CYDEV_CHIP_REVISION_5A_PRODUCTION EQU 1
CYDEV_CHIP_REVISION_5B_ES0 EQU 0
CYDEV_CHIP_REVISION_5B_PRODUCTION EQU 0
CYDEV_CHIP_REVISION_USED EQU CYDEV_CHIP_REVISION_4A_PRODUCTION
CYDEV_CHIP_REV_EXPECT EQU CYDEV_CHIP_REVISION_USED
CYDEV_CONFIG_READ_ACCELERATOR EQU 1
CYDEV_CONFIG_UNUSED_IO_AllowButWarn EQU 0
CYDEV_CONFIG_UNUSED_IO EQU CYDEV_CONFIG_UNUSED_IO_AllowButWarn
CYDEV_CONFIG_UNUSED_IO_AllowWithInfo EQU 1
CYDEV_CONFIG_UNUSED_IO_Disallowed EQU 2
CYDEV_CONFIGURATION_COMPRESSED EQU 1
CYDEV_CONFIGURATION_MODE_COMPRESSED EQU 0
CYDEV_CONFIGURATION_MODE EQU CYDEV_CONFIGURATION_MODE_COMPRESSED
CYDEV_CONFIGURATION_MODE_DMA EQU 2
CYDEV_CONFIGURATION_MODE_UNCOMPRESSED EQU 1
CYDEV_DEBUG_PROTECT_KILL EQU 4
CYDEV_DEBUG_PROTECT_OPEN EQU 1
CYDEV_DEBUG_PROTECT EQU CYDEV_DEBUG_PROTECT_OPEN
CYDEV_DEBUG_PROTECT_PROTECTED EQU 2
CYDEV_DEBUGGING_DPS_Disable EQU 3
CYDEV_DEBUGGING_DPS_SWD EQU 2
CYDEV_DEBUGGING_DPS EQU CYDEV_DEBUGGING_DPS_SWD
CYDEV_DEBUGGING_ENABLE EQU 1
CYDEV_HEAP_SIZE EQU 0x80
CYDEV_PROJ_TYPE EQU 0
CYDEV_PROJ_TYPE_BOOTLOADER EQU 1
CYDEV_PROJ_TYPE_LOADABLE EQU 2
CYDEV_PROJ_TYPE_MULTIAPPBOOTLOADER EQU 3
CYDEV_PROJ_TYPE_STANDARD EQU 0
CYDEV_STACK_SIZE EQU 0x0400
CYDEV_USE_BUNDLED_CMSIS EQU 1
CYDEV_VARIABLE_VDDA EQU 1
CYDEV_VDDA EQU 5
CYDEV_VDDA_MV EQU 5000
CYDEV_VDDD EQU 5
CYDEV_VDDD_MV EQU 5000
CYIPBLOCK_M0S8_CTBM_VERSION EQU 0
CYIPBLOCK_m0s8cpuss_VERSION EQU 0
CYIPBLOCK_m0s8csd_VERSION EQU 0
CYIPBLOCK_m0s8gpio2_VERSION EQU 0
CYIPBLOCK_m0s8hsiom4a_VERSION EQU 0
CYIPBLOCK_m0s8lcd_VERSION EQU 0
CYIPBLOCK_m0s8lpcomp_VERSION EQU 0
CYIPBLOCK_m0s8pclk_VERSION EQU 0
CYIPBLOCK_m0s8sar_VERSION EQU 0
CYIPBLOCK_m0s8scb_VERSION EQU 0
CYIPBLOCK_m0s8srssv2_VERSION EQU 1
CYIPBLOCK_m0s8tcpwm_VERSION EQU 0
CYIPBLOCK_m0s8udbif_VERSION EQU 0
CYIPBLOCK_S8_GPIO_VERSION EQU 2
CYDEV_BOOTLOADER_ENABLE EQU 0
    ENDIF
    END
